## conf/layer.conf
```bitbake
# We have a conf and classes directory, add to BBPATH
BBPATH .= ":${LAYERDIR}"

# We have recipes-* directories, add to BBFILES
BBFILES += "${LAYERDIR}/recipes-*/*/*.bb \
            ${LAYERDIR}/recipes-*/*/*.bbappend"

BBFILE_COLLECTIONS += "mir"
BBFILE_PATTERN_mir = "^${LAYERDIR}/"
BBFILE_PRIORITY_mir = "7"

LAYERDEPENDS_mir = "core openembedded-layer"
LAYERSERIES_COMPAT_mir = "scarthgap styhead"
```
